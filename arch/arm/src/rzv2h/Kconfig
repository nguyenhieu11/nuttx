## arch/arm/src/rzv2h/Kconfig
```kconfig
#
# For a description of the syntax of this configuration file,
# see the file kconfig-language.txt in the NuttX tools repository.
#

if ARCH_CHIP_RZV2H

# Ref: Renesas RZ/V2H datasheet - R9A09G057 part number
comment "Renesas RZ/V2H (R9A09G057) Configuration Options"

config RZV2H_SCI0
	bool "SCI0 (UART)"
	default y
	select SCI0_SERIALDRIVER
	---help---
		# Ref: Zephyr PR #91394 r9a09g057_cr8.dtsi - sci0@12800c00
		Enable SCI channel 0 for UART console.

config RZV2H_SCI_BAUDRATE
	int "SCI default baud rate"
	default 115200
	---help---
		Default baud rate for SCI UART channels.

# Ref: Zephyr PR #91394 r9a09g057_cr8.dtsi - clock-frequency = 800MHz
config RZV2H_CR8_CLK_HZ
	int "Cortex-R8 core clock frequency (Hz)"
	default 800000000
	---help---
		The Cortex-R8 core clock frequency in Hz.

# Ref: Zephyr PR #91394 r9a09g057_cr8.dtsi - timer@12c10200
config RZV2H_HAVE_PTM
	bool
	default y
	select ARMV7R_HAVE_PTM
	---help---
		The RZ/V2H Cortex-R8 has a Private Timer Module.

endif # ARCH_CHIP_RZV2H
```

## boards/arm/rzv2h/rzv2h-evk/Kconfig
```kconfig
#
# For a description of the syntax of this configuration file,
# see the file kconfig-language.txt in the NuttX tools repository.
#

if ARCH_BOARD_RZV2H_EVK

# Ref: Renesas RZ/V2H EVK Board specifications
config RZV2H_EVK_LEDS
	bool "On-board LED support"
	default y
	depends on ARCH_LEDS
	---help---
		Enable support for the on-board user LEDs on the Renesas RZ/V2H EVK board.

config RZV2H_EVK_BUTTONS
	bool "On-board User Button support"
	default n
	depends on INPUT
	---help---
		Enable support for the user push buttons on the Renesas RZ/V2H EVK board.

endif # ARCH_BOARD_RZV2H_EVK
```

## boards/arm/rzv2h/rzv2h-evk/configs/nsh/defconfig
```kconfig
# Ref: qemu-armv7r configs/nsh/defconfig
# This is the defconfig for the Renesas RZ/V2H Cortex-R8 EVK board.
CONFIG_ALARM_ARCH=y
CONFIG_ARCH="arm"
CONFIG_ARCH_BOARD="rzv2h-evk"
CONFIG_ARCH_BOARD_RZV2H_EVK=y
CONFIG_ARCH_CHIP="rzv2h"
CONFIG_ARCH_CHIP_RZV2H=y
CONFIG_ARCH_CORTEXR8=y
CONFIG_ARCH_INTERRUPTSTACK=2048
CONFIG_ARCH_LOWVECTORS=y
CONFIG_BOARDCTL_POWEROFF=y
CONFIG_BOARD_LATE_INITIALIZE=y
CONFIG_BUILTIN=y
CONFIG_DEBUG_ASSERTIONS=y
CONFIG_DEBUG_FEATURES=y
CONFIG_DEBUG_FULLOPT=y
CONFIG_DEBUG_SYMBOLS=y
CONFIG_DEFAULT_TASK_STACKSIZE=4096
CONFIG_EXAMPLES_HELLO=y
CONFIG_FS_PROCFS=y
CONFIG_FS_ROMFS=y
CONFIG_HAVE_CXX=y
CONFIG_HAVE_CXXINITIALIZE=y
CONFIG_IDLETHREAD_STACKSIZE=4096
CONFIG_INIT_ENTRYPOINT="nsh_main"
CONFIG_INTELHEX_BINARY=y
CONFIG_NSH_BUILTIN_APPS=y
CONFIG_NSH_FILEIOSIZE=512
CONFIG_NSH_READLINE=y
CONFIG_PREALLOC_TIMERS=4
CONFIG_RAM_SIZE=268435456
CONFIG_RAM_START=0x00000000
CONFIG_RAW_BINARY=y
CONFIG_READLINE_CMD_HISTORY=y
CONFIG_RR_INTERVAL=200
CONFIG_RZV2H_SCI0=y
CONFIG_RZV2H_SCI_BAUDRATE=115200
CONFIG_RZV2H_CR8_CLK_HZ=800000000
CONFIG_SCHED_HAVE_PARENT=y
CONFIG_SCHED_HPWORK=y
CONFIG_SCHED_HPWORKPRIORITY=192
CONFIG_STACK_COLORATION=y
CONFIG_START_DAY=25
CONFIG_START_YEAR=2025
CONFIG_SYMTAB_ORDEREDBYNAME=y
CONFIG_SYSTEM_NSH=y
CONFIG_SYSTEM_SYSTEM=y
CONFIG_TESTING_GETPRIME=y
CONFIG_TESTING_OSTEST=y
CONFIG_UART0_SERIAL_CONSOLE=y
CONFIG_USEC_PER_TICK=1000
```
